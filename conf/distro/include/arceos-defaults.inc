## conf/distro/include/arceos-defaults.inc
```bitbake
# arceos-defaults.inc
# ArceOS 构建系统默认配置
#
# 设计原则：
# - 所有 ARCEOS_* 变量的默认值集中在此文件定义
# - 使用 ?= 赋值，允许被 machine.conf / recipe / local.conf 覆盖
# - 对应 StarryOS/Makefile 和 arceos/Makefile 中的默认值

# ==================== 构建模式 ====================
# 对应 Makefile: MODE ?= release
ARCEOS_MODE ?= "release"

# 对应 Makefile: LOG ?= warn
ARCEOS_LOG ?= "warn"

# 对应 Makefile: DWARF ?= y (在 StarryOS/Makefile 中)
ARCEOS_DWARF ?= "y"

# ==================== 设备配置 ====================
# 对应 Makefile: BUS ?= pci
ARCEOS_BUS ?= "pci"

# 对应 StarryOS/Makefile:
# export BLK := y
# export NET := y
# export VSOCK := y
ARCEOS_BLK ?= "y"
ARCEOS_NET ?= "y"
ARCEOS_VSOCK ?= "y"
ARCEOS_GRAPHIC ?= "n"
ARCEOS_INPUT ?= "n"

# ==================== 用户库配置 ====================
# StarryOS 特定: 使用 axfeat 而非 axstd
# 对应 StarryOS/Makefile:
# export NO_AXSTD := y
# export AX_LIB := axfeat
ARCEOS_NO_AXSTD ?= "y"
ARCEOS_AX_LIB ?= "axfeat"

# ==================== QEMU 配置 ====================
# 对应 StarryOS/Makefile: export MEM := 1G
ARCEOS_QEMU_MEM ?= "1G"

# 对应 arceos/Makefile: NET_DEV ?= user
ARCEOS_QEMU_NET_DEV ?= "user"

# ==================== 网络配置 ====================
# 对应 arceos/Makefile:
#   IP ?= 10.0.2.15  (QEMU 用户模式网络默认)
#   GW ?= 10.0.2.2
ARCEOS_IP ?= "10.0.2.15"
ARCEOS_GW ?= "10.0.2.2"

# ==================== Feature 默认值 ====================
# 对应 Makefile: FEATURES ?= (空)
ARCEOS_FEATURES ?= ""

# 对应 StarryOS/Makefile: APP_FEATURES := qemu
# 注意：这个应该在 recipe 中根据目标设置，这里只提供默认值
ARCEOS_APP_FEATURES ?= "qemu"

# ==================== 内存大小转换辅助 ====================
# 用于将人类可读的内存大小 (如 "1G") 转换为字节数
# 这个函数被 arceos.bbclass 中的 axconfig-gen 调用使用

def arceos_mem_to_bytes(mem_str):
    """
    将内存大小字符串转换为字节数
    对应 arceos/scripts/make/strtosz.py
    
    Examples:
        "1G" -> 1073741824
        "128M" -> 134217728
        "512K" -> 524288
    """
    import re
    match = re.match(r'^(\d+)([KMGT]?)$', mem_str.upper())
    if not match:
        return None
    
    num = int(match.group(1))
    unit = match.group(2)
    
    multipliers = {
        '': 1,
        'K': 1024,
        'M': 1024 ** 2,
        'G': 1024 ** 3,
        'T': 1024 ** 4,
    }
    
    return num * multipliers.get(unit, 1)
```

## conf/distro/include/starry-sdk-toolchain.inc
```bitbake
# StarryOS bare-metal SDK toolchain configuration
# 用于生成能够在开发主机上编译 StarryOS 应用的 SDK

# SDK 主机端工具（在 x86_64 开发机上运行）
TOOLCHAIN_HOST_TASK:append = " \
    nativesdk-rustc-bin \
    nativesdk-cargo-bin \
    nativesdk-cmake \
"

# SDK 目标端库（bare-metal stdlib，不是 Linux 用户空间）
# 根据 MACHINE 自动选择正确的 bare-metal target stdlib
# 注意：bare-metal 不需要 libc/gcc runtime，只需要 Rust stdlib

# 架构映射：从 TUNE_ARCH 到 Rust target
RUST_SDK_TARGET_ARCH = "${@rust_sdk_target_map(d)}"

def rust_sdk_target_map(d):
    """将 Yocto 的 TUNE_ARCH 映射到 Rust bare-metal target"""
    arch = d.getVar('TUNE_ARCH')
    arch_map = {
        'aarch64': 'aarch64-none',
        'riscv64': 'riscv64-none',
        'loongarch64': 'loongarch64-none',
        'x86_64': 'x86_64-none',
    }
    return arch_map.get(arch, 'aarch64-none')  # 默认 aarch64

TOOLCHAIN_TARGET_TASK = " \
    rust-std-${RUST_SDK_TARGET_ARCH} \
"

# SDK 环境变量设置脚本
SDK_TITLE = "StarryOS Bare-Metal SDK"

# 禁用 Linux userspace 相关的默认任务
TOOLCHAIN_HOST_TASK_ATTEMPTONLY = ""
```

## conf/distro/include/tcmode-loongarch64-external.inc
```bitbake
# LoongArch64 external musl toolchain (prebuilts from LoongsonLab, gcc 13.2.0)
#
# Download and unpack to /opt/loongarch64-linux-musl-cross, as described in
# StarryOS/arceos/README.md, then enable this tcmode via local.conf:
#   require conf/distro/include/tcmode-loongarch64-external.inc
#
# This bypasses building gcc/binutils inside Yocto and uses the external toolchain.

TOOLCHAIN_EXTERNAL_PREFIX ?= "loongarch64-linux-musl"
# Only override the target triple; keep native HOST_SYS/BUILD_SYS untouched.
TARGET_PREFIX:class-target = "${TOOLCHAIN_EXTERNAL_PREFIX}-"
TARGET_SYS:class-target = "${TOOLCHAIN_EXTERNAL_PREFIX}"

# external-toolchain-native installs into ${RECIPE_SYSROOT_NATIVE}${prefix}/loongarch64-linux-musl-cross
# Expose its bin/ early in PATH for dependent tasks.
PATH:prepend:class-target = "${STAGING_DIR_NATIVE}${prefix}/loongarch64-linux-musl-cross/bin:"

# Use external toolchain providers for gcc/binutils
PREFERRED_PROVIDER_virtual/${TARGET_PREFIX}gcc:loongarch64 = "loongarch64-musl-external-toolchain"
PREFERRED_PROVIDER_virtual/${TARGET_PREFIX}g++:loongarch64 = "loongarch64-musl-external-toolchain"
PREFERRED_PROVIDER_virtual/${TARGET_PREFIX}binutils:loongarch64 = "loongarch64-musl-external-toolchain"
PREFERRED_PROVIDER_virtual/${TARGET_PREFIX}compilerlibs:loongarch64 = "loongarch64-musl-external-toolchain"
# Avoid building internal libgcc/libssp; use external toolchain artifacts
PREFERRED_PROVIDER_virtual/libgcc:loongarch64 = "loongarch64-musl-external-toolchain"
PREFERRED_PROVIDER_virtual/libssp:loongarch64 = "loongarch64-musl-external-toolchain"
SKIP_RECIPE[libgcc-initial] = "1"
SKIP_RECIPE[libssp-nonshared] = "1"

# Keep musl as libc policy (can be overridden in distro if needed)
TCLIBC ?= "musl"

# Ensure tasks see the external toolchain binaries (prefer target sysroot location)
PATH:prepend:class-target = "${RECIPE_SYSROOT}/usr/loongarch64-linux-musl-cross/bin:"

# musl upstream不认 loongarch64-linux-musl 三元组，强制用裸机 softfloat 目标通过configure
EXTRA_OECONF:append:pn-musl = " --target=loongarch64-unknown-none-softfloat"
```

## conf/distro/starryos.conf
```bitbake
# starryos.conf
# StarryOS 发行版配置
#
# 设计原则：
# - 集中管理工具链版本 (Rust nightly)
# - 提供 ArceOS 构建系统默认配置
# - 保持配方专注于构建单个组件
#
# 对应关系:
#   StarryOS/Makefile 的 export 变量 -> arceos-defaults.inc
#   Rust 工具链版本 -> starry-rust-toolchain.inc

DISTRO_NAME = "starryos"
DISTRO_VERSION = "2.0"

# ==================== C 库配置 ====================
# StarryOS 发行版使用 musl C 库
TCLIBC = "musl"

# ==================== 内核配置 ====================
PREFERRED_PROVIDER_virtual/kernel = "starry"

# ==================== 镜像配置 ====================
# 设置默认 hostname
# 注意：local.conf 中的设置会覆盖这里的默认值
hostname:pn-base-files ?= "starryos"

ROOT_HOME = "/root"

# ==================== Rust 工具链选择 ====================
# 使用预编译的 nightly 工具链（rust-prebuilt-native）
# 优点：快速、包含所有 unstable features、构建可重现
PREFERRED_PROVIDER_rust-native = "rust-prebuilt-native"
PREFERRED_PROVIDER_cargo-native = "rust-prebuilt-native"

# ==================== 引入配置文件 ====================
require conf/distro/include/arceos-defaults.inc

# ==================== 包管理配置 ====================
PACKAGE_CLASSES = "package_ipk"

# musl 作为 C 库提供者
PREFERRED_PROVIDER_virtual/libc = "musl"
PREFERRED_PROVIDER_virtual/libintl = "musl"
PREFERRED_PROVIDER_virtual/libiconv = "musl"

# Use rust-prebuilt-native instead of building from source
# Mask poky's Rust recipes to avoid conflicts
BBMASK += "poky/meta/recipes-devtools/rust/"
BBMASK += "poky/meta/recipes-devtools/cargo/"

# Pin rust std version to 1.92.0 to silence preferred-version warnings
PREFERRED_VERSION_libstd-rs = "1.92.0"
PREFERRED_VERSION_libstd-rs-dev = "1.92.0"

# StarryOS is #![no_std] kernel - does NOT need libstd-rs target library
# Force RUSTLIB_DEP to empty to override poky's rust-common.bbclass default
# Note: This must be set here in distro conf to take effect before classes load
RUSTLIB_DEP = ""

# ==================== 优化构建工具 ====================
# 使用 meta-starry 的优化版工具
PREFERRED_VERSION_e2fsprogs = "1.47.1"
PREFERRED_VERSION_e2fsprogs-native = "1.47.1"
PREFERRED_VERSION_kmod = "29"
PREFERRED_VERSION_kmod-native = "29"
```

## conf/layer.conf
```bitbake
BBPATH .= ":${LAYERDIR}"
BBFILES += " \
  ${LAYERDIR}/recipes-*/*/*.bb \
  ${LAYERDIR}/recipes-*/*/*.bbappend \
"

BBFILE_COLLECTIONS += "starry"
BBFILE_PATTERN_starry := "^${LAYERDIR}/"
BBFILE_PRIORITY_starry = "7"

# Export layer directory for use in classes (e.g., for musl-headers)
LAYERDIR_meta-starry = "${LAYERDIR}"

LAYERDEPENDS_starry = "core"
LAYERSERIES_COMPAT_starry = "kirkstone mickledore nanbield scarthgap"

# Build Rust from source instead of using prebuilt binaries
# This enables full control and customization but requires 8-12 hours build time

# rust-native provides both rustc and cargo in a single package
PREFERRED_PROVIDER_cargo-native = "rust-native"
PREFERRED_PROVIDER_rustc-native = "rust-native"
PREFERRED_VERSION_rust = "1.92.0"
PREFERRED_VERSION_rust-native = "1.92.0"

PREFERRED_VERSION_rust-llvm = "1.92.0"
PREFERRED_VERSION_rust-llvm-native = "1.92.0"

# ==================== BBMASK for conflicting poky classes ====================
# meta-starry provides customized versions of these classes for:
# - Precompiled Rust toolchain support (RUSTLIB_DEP="")
# - RUSTC_BOOTSTRAP=1 for bare-metal kernel builds
# - Custom cargo configuration for bare-metal targets
#
# Mask poky's versions to avoid conflicts:
BBMASK += "poky/meta/classes(-recipe)?/rust-common\.bbclass"
BBMASK += "poky/meta/classes(-recipe)?/cargo_common\.bbclass"
BBMASK += "poky/meta/classes(-recipe)?/cargo\.bbclass"
# Note: rust.bbclass and rust-bin.bbclass are not masked as they have different
# names in meta-starry or are not conflicting
```

## conf/local.conf.sample
```bitbake
# StarryOS Yocto 构建本地配置
#
# 本文件由 meta-starry 项目生成

# ==================== 机器选择 ====================
# 可选值:
#   aarch64-qemu-virt      - ARM64 QEMU (默认)
#   riscv64-qemu-virt      - RISC-V 64 QEMU
#   loongarch64-qemu-virt  - LoongArch64 QEMU
#   x86_64-qemu-q35        - x86_64 QEMU
MACHINE ?= "aarch64-qemu-virt"

# ==================== 发行版 ====================
DISTRO = "starryos"

# ==================== ArceOS 构建参数 ====================
# 取消注释以覆盖默认值

# CPU 核心数 (默认: 4)
#ARCEOS_SMP = "8"

# 日志级别: off/error/warn/info/debug/trace (默认: warn)
#ARCEOS_LOG = "debug"

# 内存大小 (默认: 由平台配置决定)
#ARCEOS_MEM = "2G"

# 调试信息: y/n (默认: y)
#ARCEOS_DWARF = "y"

# ==================== 并行构建 ====================
# 根据你的 CPU 核心数调整
BB_NUMBER_THREADS = "8"
PARALLEL_MAKE = "-j 8"

# ==================== 跳过版本检查 ====================
# 跳过 make 4.2.1 版本警告（Kylin 是基于 Debian 的，但 sanity.bbclass 没有识别）
INHERIT:remove = "sanity"

# ==================== 下载与缓存目录 ====================
# 可选：使用共享目录加速多次构建
#DL_DIR = "/home/yean/code/downloads"
#SSTATE_DIR = "/home/yean/code/sstate"
#DL_DIR = "/home/yocto/yocto-cache/downloads"
#SSTATE_DIR = "/home/yocto/yocto-cache/sstate"


# ==================== EXTERNALSRC 配置 ====================
# 说明：
#   1. 如果使用 repo 管理多仓（推荐），starry_git.bb 会自动检测 .repo/ 目录
#      并启用 EXTERNALSRC，无需手动配置
#
#   2. 如果需要覆盖自动检测（如使用不同路径），可手动设置：
#      EXTERNALSRC_pn-starry = "/path/to/your/StarryOS"
#      EXTERNALSRC_BUILD_pn-starry = "${EXTERNALSRC_pn-starry}"
#
#
# 示例：
#EXTERNALSRC_pn-starry = "/home/yean/code/my-custom-starryos"
#EXTERNALSRC_BUILD_pn-starry = "${EXTERNALSRC_pn-starry}"

# ==================== 国内镜像源 ====================
# 使用国内镜像加速源码下载（中科院软件所镜像站）
# 注意：仅作为备选镜像，不代理 Git 仓库
#INHERIT += "own-mirrors"
#SOURCE_MIRROR_URL = "https://mirror.iscas.ac.cn/yocto/mirror/sources/"

# PREMIRRORS 会强制优先使用镜像，但镜像可能不完整，已禁用
# 如需启用，请确保镜像源有完整的文件
#PREMIRRORS:append = "\
#  git://.*/.* https://mirrors.xxx.com/yocto/git2/ \n \
#  gitsm://.*/.* https://mirrors.xxx.com/yocto/git2/ \n \
#  http://.*/.* https://mirror.iscas.ac.cn/yocto/mirror/sources/ \n \
#  https://.*/.* https://mirror.iscas.ac.cn/yocto/mirror/sources/ \n \
#  ftp://.*/.* https://mirror.iscas.ac.cn/yocto/mirror/sources/ \n \
#"

# ==================== 磁盘空间监控 ====================
BB_DISKMON_DIRS ??= "\
    STOPTASKS,${TMPDIR},1G,100K \
    STOPTASKS,${DL_DIR},1G,100K \
    STOPTASKS,${SSTATE_DIR},1G,100K \
    STOPTASKS,/tmp,100M,100K \
    HALT,${TMPDIR},100M,1K \
    HALT,${DL_DIR},100M,1K \
    HALT,${SSTATE_DIR},100M,1K \
    HALT,/tmp,10M,1K"

# ==================== 构建选项 ====================
PATCHRESOLVE = "noop"
USER_CLASSES ?= "buildstats"

# 版本标识
CONF_VERSION = "3"

# 临时配置：运行哪个测试
TEST_SUITES = "ci unixbench stress"
```

## conf/machine/aarch64-qemu-virt.conf
```bitbake
#@TYPE: Machine
#@NAME: aarch64-qemu-virt
#@DESCRIPTION: ARMv8 QEMU virt machine for StarryOS/ArceOS

# ==================== 基础架构配置 ====================
require conf/machine/include/arm/armv8a/tune-cortexa57.inc
require conf/machine/include/qemu.inc
require conf/machine/include/arceos-machine-common.inc

# ==================== ArceOS/StarryOS 平台变量 ====================
ARCEOS_ARCH = "aarch64"
ARCEOS_PLATFORM = "aarch64-qemu-virt"
ARCEOS_PLAT_PACKAGE = "axplat-aarch64-qemu-virt"
RUST_TARGET = "aarch64-unknown-none-softfloat"
ARCEOS_USE_MYPLAT ?= "0"
ARCEOS_SMP ?= "4"
ARCEOS_MEM ?= "1G"

# ==================== QEMU 基础配置 ====================
QB_SYSTEM_NAME = "qemu-system-aarch64"
QB_MACHINE = "-machine virt"
QB_CPU = "-cpu cortex-a72"
QB_CPU_KVM = "-cpu host -machine gic-version=3"
QB_MEM = "-m ${ARCEOS_MEM}"
QB_SMP = "-smp ${ARCEOS_SMP}"
QB_DEFAULT_KERNEL = "starry.bin"
QB_SERIAL_OPT = "-nographic"

SERIAL_CONSOLES = "115200;ttyAMA0"

# ==================== QEMU 网络配置 ====================
QB_SLIRP_OPT = "-netdev user,id=net0,hostfwd=tcp::5555-:5555,hostfwd=udp::5555-:5555"
QB_NETWORK_DEVICE = "-device virtio-net-pci,netdev=net0,mac=@MAC@"
# 禁用内核命令行 IP 配置（StarryOS 使用内置 IP 配置）
QB_CMDLINE_IP_SLIRP = ""

# ==================== QEMU 块设备配置 ====================
QB_DRIVE_TYPE = "/dev/vda"
QB_ROOTFS_OPT = "-drive id=disk0,file=@ROOTFS@,if=none,format=raw -device virtio-blk-pci,drive=disk0"

# ==================== QEMU 显示/输入配置 ====================
# QB_GRAPHICS 会触发 runqemu 的 SDL 显示模式
# 如果 QEMU 没有 SDL 支持，需要禁用图形或使用其他显示方式
#
# 方式1：无图形模式（默认，通过串口交互）
# QB_GRAPHICS = ""
#
# 方式2：有图形模式（需要 SDL/VNC 支持）
# QB_GRAPHICS = "-device virtio-gpu-pci -display vnc=:0"
#
# 当前配置：无图形模式，但仍添加 virtio 输入设备供将来使用
QB_OPT_APPEND = "-device virtio-mouse-pci -device virtio-keyboard-pci"

# ==================== QEMU VSOCK 配置 ====================
# 对应 qemu.mk: VSOCK=y
# 注意：需要宿主机 /dev/vhost-vsock 且用户在 kvm 组中
QB_OPT_APPEND:append = " -device vhost-vsock-pci,id=virtiosocket0,guest-cid=103"
```

## conf/machine/include/loongarch/arch-loongarch.inc
```bitbake
# LoongArch Architecture definition

DEFAULTTUNE ?= "loongarch64"
TUNE_ARCH = "${TUNE_ARCH:tune-${DEFAULTTUNE}}"
TUNE_PKGARCH = "${TUNE_PKGARCH:tune-${DEFAULTTUNE}}"
# 根据 TUNE_FEATURES 里的 ABI 标记追加编译器参数
TUNE_CCARGS:append = "${@bb.utils.contains('TUNE_FEATURES', 'loongarch64nf', ' -mabi=lp64', '', d)}"

# Fix: ld: unrecognized option '--hash-style=sysv'
LINKER_HASH_STYLE:libc-newlib = ""
# Fix: ld: unrecognized option '--hash-style=gnu'
LINKER_HASH_STYLE:libc-baremetal = ""

# Provide siteinfo entries for loongarch targets (endianness/bits)
SITEINFO_EXTRA_DATAFUNCS += "loongarch_siteinfo"
def loongarch_siteinfo(archinfo, osinfo, targetinfo, d):
    archinfo["loongarch64"] = "endian-little bit-64 loongarch-common"
    targetinfo["loongarch64-linux"] = "bit-64"
    targetinfo["loongarch64-linux-gnu"] = "bit-64"
    targetinfo["loongarch64-linux-musl"] = "bit-64"
    return archinfo, osinfo, targetinfo
```

## conf/machine/riscv64-qemu-virt.conf
```bitbake
#@TYPE: Machine
#@NAME: riscv64-qemu-virt
#@DESCRIPTION: RISC-V 64-bit QEMU virt machine for StarryOS/ArceOS

# 基础架构配置
require conf/machine/include/riscv/tune-riscv.inc
require conf/machine/include/qemu.inc

# ArceOS 通用配置
require conf/machine/include/arceos-machine-common.inc

# ==================== ArceOS/StarryOS 必须变量 ====================
# 对应 Makefile: ARCH, PLAT_NAME, MYPLAT, TARGET
ARCEOS_ARCH = "riscv64"
ARCEOS_PLATFORM = "riscv64-qemu-virt"
ARCEOS_PLAT_PACKAGE = "axplat-riscv64-qemu-virt"
RUST_TARGET = "riscv64gc-unknown-none-elf"

# ==================== RISC-V 架构配置 ====================
DEFAULTTUNE = "riscv64"
TUNE_ARCH = "riscv64"
TUNE_PKGARCH = "riscv64"

# ==================== 平台默认值 ====================
ARCEOS_SMP ?= "4"

# ==================== QEMU 配置 ====================
QB_SYSTEM_NAME = "qemu-system-riscv64"
QB_MACHINE = "-machine virt"
QB_CPU = "-cpu rv64"
QB_MEM = "-m 2048"
QB_SMP = "-smp ${ARCEOS_SMP}"
QB_KERNEL_CMDLINE_APPEND = "console=ttyS0"
QB_DTB = ""
QB_DEFAULT_KERNEL = "starry.bin"

SERIAL_CONSOLES = "115200;ttyS0"
```
