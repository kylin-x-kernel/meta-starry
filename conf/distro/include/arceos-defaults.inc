## conf/machine/x86_64-qemu-q35.conf
```bitbake
#@TYPE: Machine
#@NAME: x86_64-qemu-q35
#@DESCRIPTION: x86_64 QEMU Q35 machine for StarryOS/ArceOS

# 基础架构配置
require conf/machine/include/qemu.inc
DEFAULTTUNE ?= "core2-64"
require conf/machine/include/x86/tune-core2.inc
require conf/machine/include/x86/qemuboot-x86.inc

# ArceOS 通用配置
require conf/machine/include/arceos-machine-common.inc

# ==================== ArceOS/StarryOS 必须变量 ====================
# 对应 Makefile: ARCH, PLAT_NAME, MYPLAT, TARGET
ARCEOS_ARCH = "x86_64"
ARCEOS_PLATFORM = "x86_64-qemu-q35"
ARCEOS_PLAT_PACKAGE = "axplat-x86-pc"
RUST_TARGET = "x86_64-unknown-none"

# ==================== 平台默认值 ====================
ARCEOS_SMP ?= "4"

# ==================== QEMU 配置 ====================
QB_SYSTEM_NAME = "qemu-system-x86_64"
QB_MACHINE = "-machine q35"
QB_CPU = "-cpu qemu64"
QB_MEM = "-m 2048"
QB_SMP = "-smp ${ARCEOS_SMP}"
QB_KERNEL_CMDLINE_APPEND = "console=ttyS0"
QB_DEFAULT_KERNEL = "starry.elf"

# x86_64 使用 ELF 格式而非 bin
KERNEL_IMAGETYPE = "elf"

SERIAL_CONSOLES = "115200;ttyS0"
```

## meta-starry/conf/distro/include/tclibc-none.inc
```bitbake
# Bare-metal / no-libc configuration
#
# Provides a minimal libc policy so that TCLIBC="none" can be selected without
# pulling any userspace C library recipes.

LIBCEXTENSION = ""
LIBCOVERRIDE = ":libc-none"

PREFERRED_PROVIDER_virtual/libc ?= ""
PREFERRED_PROVIDER_virtual/libiconv ?= ""
PREFERRED_PROVIDER_virtual/libintl ?= ""
PREFERRED_PROVIDER_virtual/crypt ?= ""

# Skip common libc implementations entirely
SKIP_RECIPE[musl] = "1"
SKIP_RECIPE[glibc] = "1"
SKIP_RECIPE[newlib] = "1"

# Nothing to stage into images
LIBC_DEPENDENCIES = ""
```

## meta-starry/conf/local.conf.sample
```bitbake
#
# StarryOS Bare-Metal Kernel Build Configuration

#

# ==================== Machine Selection ====================
# 目标平台选择
MACHINE ??= "aarch64-qemu-virt"

# ==================== Build System Configuration ====================
# 发行版配置
DISTRO ?= "starryos"

# 下载目录
#DL_DIR ?= "${TOPDIR}/downloads"

# 共享状态缓存目录
#SSTATE_DIR ?= "${TOPDIR}/sstate-cache"

# 临时构建目录
#TMPDIR = "${TOPDIR}/tmp"

# ==================== Bare-Metal Specific Settings ====================
# C 库设置为 baremetal（由 machine 配置文件设置，这里不重复）
# TCLIBC 已在 meta-starry/conf/machine/*.conf 中设置



# 禁用 BitBake 网络隔离
BB_NO_NETWORK = "0"

# 完全禁用网络隔离功能（避免 Operation not permitted 错误）
BB_TASK_NETWORK = "1"

# ==================== Package Management ====================
# 裸机内核不需要打包系统
# PACKAGE_CLASSES 已在 distro 配置中设置
# INHIBIT_PACKAGE_INSTALL 已在 distro 配置中设置

# ==================== Build Performance ====================
# 构建统计
USER_CLASSES ?= "buildstats"

# 并行构建配置，这里上限为自己本地的nproc
BB_NUMBER_THREADS = "26"
PARALLEL_MAKE = "-j 26"

# ==================== Interactive Configuration ====================
# 补丁解决策略（非交互式）
PATCHRESOLVE = "noop"

# ==================== Disk Space Monitoring ====================
BB_DISKMON_DIRS ??= "\
    STOPTASKS,${TMPDIR},1G,100K \
    STOPTASKS,${DL_DIR},1G,100K \
    STOPTASKS,${SSTATE_DIR},1G,100K \
    STOPTASKS,/tmp,100M,100K \
    HALT,${TMPDIR},100M,1K \
    HALT,${DL_DIR},100M,1K \
    HALT,${SSTATE_DIR},100M,1K \
    HALT,/tmp,10M,1K"

# ==================== QEMU Configuration ====================
# QEMU SDL 支持（用于测试运行）
PACKAGECONFIG:append:pn-qemu-system-native = " sdl"



# ==================== Build Configuration Version ====================
CONF_VERSION = "2"
```

## meta-starry/conf/machine/aarch64-qemu-virt.conf
```bitbake
#@TYPE: Machine
#@NAME: aarch64-qemu-virt
#@DESCRIPTION: ARMv8 QEMU virt machine for StarryOS/ArceOS

# Inherit base ARM and QEMU configuration
require conf/machine/include/arm/armv8a/tune-cortexa57.inc
require conf/machine/include/qemu.inc

# ==================== ArceOS/StarryOS Configuration ====================
# Architecture and platform package
ARCEOS_ARCH = "aarch64"
ARCEOS_PLATFORM = "aarch64-qemu-virt"
ARCEOS_PLAT_PACKAGE = "axplat-aarch64-qemu-virt"

# Rust target triple (bare-metal, no OS)
RUST_TARGET = "aarch64-unknown-none-softfloat"

# StarryOS is a bare-metal kernel, no libc needed
PREFERRED_PROVIDER_virtual/kernel = "starry"

# Override kernel image type for bare-metal
KERNEL_IMAGETYPE = "bin"

# Default ArceOS configuration (can be overridden in recipes)
ARCEOS_SMP ?= "4"
ARCEOS_LOG ?= "warn"

# Default Cargo features for QEMU platform
# Enables: virtio-net, virtio-gpu, virtio-input, virtio-socket, PCI bus
# axfeat/defplat: default platform configuration
# axfeat/dwarf: DWARF debug info
# axfeat/smp: SMP support (multi-core)
CARGO_FEATURES ?= "axfeat/defplat axfeat/dwarf axfeat/smp qemu"

# ==================== QEMU Configuration ====================
QB_SYSTEM_NAME = "qemu-system-aarch64"
QB_MACHINE = "-machine virt"
QB_CPU = "-cpu cortex-a57"
QB_SMP = "-smp 4"
QB_MEM = "-m 2048"
QB_OPT_APPEND = "-nographic"
QB_KERNEL_CMDLINE_APPEND = "console=ttyAMA0"

SERIAL_CONSOLES = "115200;ttyAMA0"
```

## meta-starry/conf/machine/aarch64-raspi.conf
```bitbake
#@TYPE: Machine
#@NAME: aarch64-raspi
#@DESCRIPTION: Raspberry Pi 4 (64-bit) board for StarryOS/ArceOS

require conf/machine/include/arm/armv8a/tune-cortexa72.inc

# ==================== ArceOS/StarryOS Configuration ====================
# Architecture and platform package
ARCEOS_ARCH = "aarch64"
ARCEOS_PLAT_PACKAGE = "axplat-aarch64-raspi"  # 不同！

# Rust target triple (bare-metal, no OS)
RUST_TARGET = "aarch64-unknown-none-softfloat"

# StarryOS is a bare-metal kernel, no libc needed
PREFERRED_PROVIDER_virtual/kernel = "starry"


# ==================== Raspberry Pi 4B Hardware ====================
# 注意：这些地址和 QEMU 不同！
# axplat-aarch64-raspi 的 axconfig.toml 会定义：
# - phys-memory-base = 0x0000_0000 (vs QEMU 的 0x4000_0000)
# - uart-paddr = 0xFE201000 (vs QEMU 的 0x0900_0000)
# - 其他外设地址也不同

KERNEL_IMAGETYPE = "bin"

# 真实硬件部署需要：
# 1. SD 卡启动配置 (config.txt, bootcode.bin)
# 2. 将 starry.bin 放到 SD 卡作为 kernel8.img
# 3. 或通过 JTAG 调试器烧录
```

## meta-starry/conf/machine/include/loongarch/tune-loongarch.inc
```bitbake
require conf/machine/include/loongarch/arch-loongarch.inc

TUNEVALID[loongarch64] = "Enable 64-bit LoongArch optimizations"

TUNEVALID[loongarch64nf] = "Enable 64-bit LoongArch optimizations no floating point"

TUNEVALID[bigendian] = "Big endian mode"

AVAILTUNES += "loongarch64 loongarch64nf"

# Default

TUNE_FEATURES:tune-loongarch64 = "loongarch64"
TUNE_ARCH:tune-loongarch64 = "loongarch64"
TUNE_PKGARCH:tune-loongarch64 = "loongarch64"
PACKAGE_EXTRA_ARCHS:tune-loongarch64 = "loongarch64"

# No float
TUNE_FEATURES:tune-loongarch64nf = "${TUNE_FEATURES:tune-loongarch64nf} loongarch64nf"
TUNE_ARCH:tune-loongarch64nf = "loongarch64nf"
TUNE_PKGARCH:tune-loongarch64nf = "loongarch64nf"
PACKAGE_EXTRA_ARCHS:tune-loongarch64nf = "loongarch64nf"
```

## meta-starry/conf/machine/loongarch64-qemu-virt.conf
```bitbake
#@TYPE: Machine
#@NAME: loongarch64-qemu-virt
#@DESCRIPTION: LoongArch 64-bit QEMU virt machine for StarryOS/ArceOS

# ==================== ArceOS/StarryOS Configuration ====================
# Architecture and platform package
ARCEOS_ARCH = "loongarch64"
ARCEOS_PLAT_PACKAGE = "axplat-loongarch64-qemu-virt"

# Rust target triple (bare-metal, no OS)
RUST_TARGET = "loongarch64-unknown-none-softfloat"

# StarryOS is a bare-metal kernel
PREFERRED_PROVIDER_virtual/kernel = "starry"
# TCMODE = "external-loongarch64-musl"  # 暂时注释，等有工具链再启用

# ==================== LoongArch64 Architecture ====================
# LoongArch tune definitions live under include/loongarch/
require conf/machine/include/loongarch/tune-loongarch.inc
require conf/machine/include/qemu.inc

# The StarryOS LoongArch platform expects a virt-style board with a 16550 UART.
KERNEL_IMAGETYPE = "bin"

SERIAL_CONSOLES ?= "115200;ttyS0"
SERIAL_CONSOLES_CHECK = "${SERIAL_CONSOLES}"

# Minimal tune/pkgarch hints until a full tune lands
TUNE_PKGARCH = "loongarch64"
PACKAGE_EXTRA_ARCHS = "loongarch64"
KERNEL_ARCH = "loongarch"
valid_archs:prepend = "loongarch loongarch64 "

# ==================== QEMU Configuration ====================
# runqemu parameters
QB_SYSTEM_NAME = "qemu-system-loongarch64"
QB_MACHINE = "-machine virt"
QB_CPU ?= "-cpu la464"
QB_SMP ?= "-smp 4"
QB_MEM ?= "-m 2048"
QB_NETWORK_DEVICE = "-device virtio-net-pci,netdev=net0,mac=@MAC@"
QB_TAP_OPT = "-netdev tap,id=net0,ifname=@TAP@,script=no,downscript=no"
QB_ROOTFS_OPT = "-drive id=disk0,file=@ROOTFS@,if=none,format=raw -device virtio-blk-pci,drive=disk0"
QB_SERIAL_OPT = "-serial mon:stdio"
QB_TCPSERIAL_OPT = "-serial tcp:127.0.0.1:@PORT@,server,nowait"
QB_OPT_APPEND = "-device virtio-tablet-pci -device virtio-keyboard-pci"
QB_KERNEL_CMDLINE_APPEND = "console=ttyS0"
```

## meta-starry/conf/machine/riscv64-qemu-virt.conf
```bitbake
#@TYPE: Machine
#@NAME: riscv64-qemu-virt
#@DESCRIPTION: RISC-V 64-bit QEMU virt machine for StarryOS/ArceOS

require conf/machine/include/riscv/tune-riscv.inc
require conf/machine/include/qemu.inc

# ==================== ArceOS/StarryOS Configuration ====================
# Architecture and platform package
ARCEOS_ARCH = "riscv64"
ARCEOS_PLAT_PACKAGE = "axplat-riscv64-qemu-virt"

# Rust target triple (bare-metal, no OS)
RUST_TARGET = "riscv64gc-unknown-none-elf"

# StarryOS is a bare-metal kernel, no libc needed
PREFERRED_PROVIDER_virtual/kernel = "starry"

# ==================== RISC-V Configuration ====================
DEFAULTTUNE = "riscv64"
TUNE_ARCH = "riscv64"
TUNE_PKGARCH = "riscv64"

# ==================== QEMU Configuration ====================
QB_SYSTEM_NAME = "qemu-system-riscv64"
QB_MACHINE = "-machine virt"
QB_CPU = "-cpu rv64"
QB_MEM = "-m 2048"
QB_SMP = "-smp 4"
QB_KERNEL_CMDLINE_APPEND = "console=ttyS0"
QB_DEFAULT_FSTYPE = "ext4"
QB_DTB = ""
QB_OPT_APPEND = "-nographic"

KERNEL_IMAGETYPE = "bin"
KERNEL_DEVICETREE = ""

SERIAL_CONSOLES = "115200;ttyS0"
SERIAL_CONSOLES_CHECK = "${SERIAL_CONSOLES}"
```

## meta-starry/conf/machine/x86_64-qemu-q35.conf
```bitbake
#@TYPE: Machine
#@NAME: x86_64-qemu-q35
#@DESCRIPTION: x86_64 QEMU Q35 machine for StarryOS/ArceOS

require conf/machine/include/x86/x86-64-common.inc
require conf/machine/include/qemu.inc

# ==================== ArceOS/StarryOS Configuration ====================
# Architecture and platform package
ARCEOS_ARCH = "x86_64"
ARCEOS_PLAT_PACKAGE = "axplat-x86-pc"

# Rust target triple (bare-metal, no OS)
RUST_TARGET = "x86_64-unknown-none"

# StarryOS is a bare-metal kernel, no libc needed
PREFERRED_PROVIDER_virtual/kernel = "starry"


# ==================== QEMU Configuration ====================
QB_SYSTEM_NAME = "qemu-system-x86_64"
QB_MACHINE = "-machine q35"
QB_CPU = "-cpu qemu64"
QB_MEM = "-m 2048"
QB_SMP = "-smp 4"
QB_KERNEL_CMDLINE_APPEND = "console=ttyS0"
QB_DEFAULT_FSTYPE = "ext4"
QB_OPT_APPEND = "-nographic"

KERNEL_IMAGETYPE = "elf"

SERIAL_CONSOLES = "115200;ttyS0"
SERIAL_CONSOLES_CHECK = "${SERIAL_CONSOLES}"
```
